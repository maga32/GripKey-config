## boards/shields/gripKey/Kconfig.defconfig
```kconfig
# RIGHT
if SHIELD_GRIPKEY_R

config ZMK_KEYBOARD_NAME
    default "gripKey"

config ZMK_SPLIT_ROLE_CENTRAL
    default y

endif

# Split mode
if SHIELD_GRIPKEY_L || SHIELD_GRIPKEY_R

config ZMK_SPLIT
    default y

config ZMK_POINTING
    default y

endif
```

## boards/shields/gripKey/Kconfig.shield
```kconfig
config SHIELD_GRIPKEY_R
    def_bool $(shields_list_contains,gripKey_right)

config SHIELD_GRIPKEY_L
    def_bool $(shields_list_contains,gripKey_left)
```
